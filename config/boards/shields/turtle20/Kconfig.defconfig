## config/boards/shields/turtle20/Kconfig.defconfig
```kconfig
# Copyright (c) 2020 The ZMK Contributors
# SPDX-License-Identifier: MIT

config ZMK_BLE
	default y

config ZMK_USB
	default y

if SHIELD_TURTLE20_DONGLE || SHIELD_TURTLE20_NORM_LEFT || SHIELD_TURTLE20_NORM_RIGHT

config ZMK_KEYBOARD_NAME
	default "Turtle20"

endif

if SHIELD_TURTLE20_DONGLE_LEFT || SHIELD_TURTLE20_DONGLE_RIGHT || SHIELD_TURTLE20_NORM_RIGHT

config ZMK_SPLIT
	default y

endif



if SHIELD_TURTLE20_DONGLE || SHIELD_TURTLE20_NORM_LEFT

config ZMK_SPLIT
	default y

config ZMK_SPLIT_BLE_ROLE_CENTRAL
	default y

endif
```

## config/boards/shields/turtle20/Kconfig.shield
```kconfig
# Copyright (c) 2020 The ZMK Contributors
# SPDX-License-Identifier: MIT

config SHIELD_TURTLE20_DONGLE_LEFT
	def_bool $(shields_list_contains,turtle20_dongle_left)

config SHIELD_TURTLE20_DONGLE_RIGHT
	def_bool $(shields_list_contains,turtle20_dongle_right)

config SHIELD_TURTLE20_DONGLE
	def_bool $(shields_list_contains,turtle20_dongle)

config SHIELD_TURTLE20_NORM_LEFT
	def_bool $(shields_list_contains,turtle20_norm_left)

config SHIELD_TURTLE20_NORM_RIGHT
	def_bool $(shields_list_contains,turtle20_norm_right)
```

## config/west.yml
```yaml
manifest:
  remotes:
    - name: slicemk
      url-base: https://github.com/slicemk
    - name: talf301
      url-base: https://github.com/talf301
  projects:
    - name: zmk
      remote: talf301
      revision: dongle-pr
      import: app/west.yml
  self:
    path: config
```
